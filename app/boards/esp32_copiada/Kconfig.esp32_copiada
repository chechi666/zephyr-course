## app/boards/esp32_copiada/Kconfig.esp32_copiada
```kconfig
# Copyright (c) 2025 Siratul Islam
# SPDX-License-Identifier: Apache-2.0

config BOARD_ESP32_COPIADA
	select SOC_ESP32_WROOM_32UE_N4
	select SOC_ESP32_PROCPU if BOARD_ESP32_COPIADA_ESP32_PROCPU
	select SOC_ESP32_APPCPU if BOARD_ESP32_COPIADA_ESP32_APPCPU
```

## app/boards/esp32_copiada/board.yml
```yaml
board:
  name: esp32_copiada
  full_name: ESP32 Copia Mia
  vendor: Diego
  socs:
    - name: esp32
```

## app/boards/esp32_from_scratch/Kconfig.esp32_from_scratch
```kconfig
# Copyright (c) 2025 Siratul Islam
# SPDX-License-Identifier: Apache-2.0

config BOARD_ESP32_FROM_SCRATCH
	select SOC_ESP32_WROOM_32UE_N4
	select SOC_ESP32_PROCPU

config HEAP_MEM_POOL_ADD_SIZE_BOARD
	int
	default 4096
```

## app/boards/esp32_from_scratch/board.yml
```yaml
board:
  name: esp32_from_scratch
  full_name: ESP32 Copia Mia
  vendor: Diego
  socs:
    - name: esp32
```

## west.yml
```yaml
manifest:
  version: 1.0

  projects:
    - name: zephyr
      url: https://github.com/zephyrproject-rtos/zephyr
      revision: v4.4.0
      import:
        name-allowlist:
          - hal_espressif
          - hal_nordic
        path-prefix: deps
```
